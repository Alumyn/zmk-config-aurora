## config/west.yml
```yaml
manifest:
  remotes:
    - name: zmkfirmware
      url-base: https://github.com/zmkfirmware
    - name: splitkb
      url-base: https://github.com/splitkb
  projects:
    - name: zmk
      remote: zmkfirmware
      revision: v3.5
      import: app/west.yml
    - name: zmk-config-aurora
      remote: splitkb
      revision: main
  self:
    path: config
```
